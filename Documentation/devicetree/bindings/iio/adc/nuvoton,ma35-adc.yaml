## Documentation/devicetree/bindings/iio/adc/nuvoton,ma35-adc.yaml
```yaml
# SPDX-License-Identifier: (GPL-2.0-only OR BSD-2-Clause)
%YAML 1.2
---
$id: http://devicetree.org/schemas/iio/adc/nuvoton,ma35-adc.yaml#
$schema: http://devicetree.org/meta-schemas/core.yaml#

title: Nuvoton MA35 series ADC controller

maintainers:
  - Nuvoton Technology Corporation <www.nuvoton.com>

description: Nuvoton MA35 series successive-approximation ADC controller.

properties:
  compatible:
    enum:
      - nuvoton,ma35d0-adc
      - nuvoton,ma35d1-adc
      - nuvoton,ma35h0-adc

  reg:
    maxItems: 1

  interrupts:
    maxItems: 1

  clocks:
    maxItems: 1

  clock-names:
    const: adc_gate

  clock-rate:
    description: ADC clock frequency in Hz.
    minimum: 1

  nuvoton,adc-vref:
    description: ADC reference voltage in millivolts.
    minimum: 1

  nuvoton,min-clock-frequency:
    description: Threshold for selecting the ADC low-speed clock mode, in Hz.
    minimum: 1

  nuvoton,max-clock-frequency:
    description: Maximum supported ADC clock frequency, in Hz.
    minimum: 1

  '#io-channel-cells':
    const: 1

  enable-iio: true
  enable-ts: true
  ts-type:
    enum: [4, 5]

required:
  - compatible
  - reg
  - interrupts
  - clocks
  - clock-names
  - nuvoton,adc-vref
  - '#io-channel-cells'

unevaluatedProperties: false

examples:
  - |
    adc@40420000 {
      compatible = "nuvoton,ma35d1-adc";
      reg = <0x0 0x40420000 0x0 0x500>;
      interrupts = <GIC_SPI 80 IRQ_TYPE_LEVEL_HIGH>;
      clocks = <&clk ADC_GATE>;
      clock-names = "adc_gate";
      clock-rate = <200000>;
      nuvoton,adc-vref = <3300>;
      nuvoton,min-clock-frequency = <3200000>;
      nuvoton,max-clock-frequency = <16000000>;
      #io-channel-cells = <1>;
    };
```

## Documentation/devicetree/bindings/iio/adc/nuvoton,ma35d1-eadc.yaml
```yaml
# SPDX-License-Identifier: (GPL-2.0-only OR BSD-2-Clause)
%YAML 1.2
---
$id: http://devicetree.org/schemas/iio/adc/nuvoton,ma35d1-eadc.yaml#
$schema: http://devicetree.org/meta-schemas/core.yaml#

title: Nuvoton MA35D1 EADC controller

maintainers:
  - Chi-Wen Weng <cwweng@nuvoton.com>

description: Nuvoton MA35D1 enhanced ADC controller.

properties:
  compatible:
    const: nuvoton,ma35d1-eadc

  reg:
    maxItems: 1

  interrupts:
    maxItems: 1

  clocks:
    maxItems: 1

  clock-names:
    const: eadc_gate

  eadc-frequency:
    $ref: /schemas/types.yaml#/definitions/uint32
    description: EADC clock frequency in Hz.
    minimum: 1

  eadc-channels:
    $ref: /schemas/types.yaml#/definitions/uint32-array
    description: Single-ended EADC input channel numbers.
    minItems: 1
    maxItems: 8
    items:
      minimum: 0
      maximum: 7

  eadc-diff-channels:
    $ref: /schemas/types.yaml#/definitions/uint32-array
    description: Differential EADC channels as positive/negative pairs.
    minItems: 2
    maxItems: 16
    items:
      minimum: 0
      maximum: 7

  dmas:
    maxItems: 1

  dma-names:
    const: rx

  use_pdma:
    $ref: /schemas/types.yaml#/definitions/uint32
    enum: [0, 1]

  pdma_reqsel_rx:
    $ref: /schemas/types.yaml#/definitions/uint32
    minimum: 0
    maximum: 255


required:
  - compatible
  - reg
  - interrupts
  - clocks
  - clock-names
  - eadc-frequency

unevaluatedProperties: false

examples:
  - |
    eadc@40430000 {
      compatible = "nuvoton,ma35d1-eadc";
      reg = <0x0 0x40430000 0x0 0x10000>;
      interrupts = <GIC_SPI 65 IRQ_TYPE_LEVEL_HIGH>;
      clocks = <&clk EADC_GATE>;
      clock-names = "eadc_gate";
      eadc-frequency = <10000000>;
      eadc-channels = <0 1 2 3 4 5 6 7>;
    };
```

## Documentation/devicetree/bindings/rtc/nuvoton,ma35d1-rtc.yaml
```yaml
# SPDX-License-Identifier: (GPL-2.0-only OR BSD-2-Clause)
%YAML 1.2
---
$id: http://devicetree.org/schemas/rtc/nuvoton,ma35d1-rtc.yaml#
$schema: http://devicetree.org/meta-schemas/core.yaml#

title: Nuvoton MA35D1 Real Time Clock

maintainers:
  - Min-Jen Chen <mjchen@nuvoton.com>

allOf:
  - $ref: rtc.yaml#

properties:
  compatible:
    enum:
      - nuvoton,ma35d0-rtc
      - nuvoton,ma35d1-rtc
      - nuvoton,ma35h0-rtc

  reg:
    maxItems: 1

  interrupts:
    maxItems: 1

  clocks:
    maxItems: 1

  lxt-detect-enable:
    $ref: /schemas/types.yaml#/definitions/uint32
    enum: [0, 1]

  enable-wakeup:
    type: boolean

required:
  - compatible
  - reg
  - interrupts
  - clocks

unevaluatedProperties: false

examples:
  - |
    #include <dt-bindings/interrupt-controller/arm-gic.h>
    #include <dt-bindings/clock/nuvoton,ma35d1-clk.h>
    rtc@40410000 {
        compatible = "nuvoton,ma35d1-rtc";
        reg = <0x40410000 0x200>;
        interrupts = <GIC_SPI 5 IRQ_TYPE_EDGE_RISING>;
        clocks = <&clk RTC_GATE>;
    };

...
```

## Documentation/devicetree/bindings/serial/nuvoton,ma35d1-serial.yaml
```yaml
# SPDX-License-Identifier: (GPL-2.0-only OR BSD-2-Clause)
%YAML 1.2
---
$id: http://devicetree.org/schemas/serial/nuvoton,ma35d1-uart.yaml#
$schema: http://devicetree.org/meta-schemas/core.yaml#

title: Nuvoton MA35 Series UART Controller

description: |
  Devicetree bindings for the UART controllers found in Nuvoton
  MA35D1, MA35H0 and MA35D0 SoCs.

maintainers:
  - Nuvoton Technology Corporation <cwweng@nuvoton.com>

properties:
  compatible:
    enum:
      - nuvoton,ma35d1-uart
      - nuvoton,ma35h0-uart
      - nuvoton,ma35d0-uart

  reg:
    maxItems: 1

  interrupts:
    maxItems: 1

  clocks:
    maxItems: 1

  ma35d1-console:
    description: Indicates that this UART is used as the system console.
    type: boolean

  port-number:
    description: UART port index assigned to this controller.
    $ref: /schemas/types.yaml#/definitions/uint32
    minimum: 0
    maximum: 16

  pdma-enable:
    description: Enable (1) or disable (0) UART PDMA transfers.
    $ref: /schemas/types.yaml#/definitions/uint32
    enum: [0, 1]

  dmas:
    minItems: 1
    maxItems: 2

  dma-names:
    minItems: 1
    maxItems: 2
    items:
      enum: [tx, rx]

  nuvoton,pdma-reqsel-tx:
    description: |
      UART TX PDMA request selector. Read by the MA35D1 and MA35D0
      drivers when PDMA is enabled; MA35H0 selects the request internally.
    $ref: /schemas/types.yaml#/definitions/uint32
    enum: [4, 6, 8, 10, 12, 14, 16, 18, 20, 22, 24, 26, 28, 30,
           32, 34, 36]

  nuvoton,pdma-reqsel-rx:
    description: |
      UART RX PDMA request selector. Required by the MA35D1 and MA35D0
      drivers only when EN_UART_PDMA_RX is compiled in and PDMA is enabled.
    $ref: /schemas/types.yaml#/definitions/uint32
    enum: [5, 7, 9, 11, 13, 15, 17, 19, 21, 23, 25, 27, 29, 31,
           33, 35, 37]

  wakeup-enable:
    description: |
      UART wakeup sources: <cts-wakeup fifo-threshold-wakeup
      fifo-timeout-wakeup>. Each cell is 0 (disabled) or 1 (enabled).
    $ref: /schemas/types.yaml#/definitions/uint32-array
    minItems: 3
    maxItems: 3
    items:
      enum: [0, 1]

  fifo-threshold:
    description: |
      RX FIFO threshold for FIFO-threshold wakeup: 1, 4, 8, 14 or 30 bytes.
    $ref: /schemas/types.yaml#/definitions/uint32
    enum: [1, 4, 8, 14, 30]

required:
  - compatible
  - reg
  - interrupts
  - clocks
  - port-number
  - pdma-enable

dependencies:
  dmas: [dma-names]
  dma-names: [dmas]

allOf:
  - $ref: serial.yaml#
  - if:
      properties:
        pdma-enable:
          const: 1
      required:
        - pdma-enable
    then:
      required:
        - dmas
        - dma-names
      properties:
        dma-names:
          contains:
            const: tx
  - if:
      properties:
        compatible:
          enum:
            - nuvoton,ma35d1-uart
            - nuvoton,ma35d0-uart
        pdma-enable:
          const: 1
      required:
        - compatible
        - pdma-enable
    then:
      required:
        - nuvoton,pdma-reqsel-tx

unevaluatedProperties: false

examples:
  - |
    #include <dt-bindings/interrupt-controller/arm-gic.h>
    #include <dt-bindings/clock/nuvoton,ma35d1-clk.h>

    serial@40700000 {
        compatible = "nuvoton,ma35d1-uart";
        reg = <0x0 0x40700000 0x0 0x10000>;
        ma35d1-console;
        interrupts = <GIC_SPI 59 IRQ_TYPE_LEVEL_HIGH>;
        clocks = <&clk UART0_GATE>;
        port-number = <0>;
        pdma-enable = <0>;
        status = "okay";
    };
  - |
    #include <dt-bindings/dma/nuvoton,ma35-pdma.h>
    #include <dt-bindings/interrupt-controller/arm-gic.h>
    #include <dt-bindings/clock/nuvoton,ma35d1-clk.h>

    serial@40710000 {
        compatible = "nuvoton,ma35d1-uart";
        reg = <0x0 0x40710000 0x0 0x10000>;
        interrupts = <GIC_SPI 60 IRQ_TYPE_LEVEL_HIGH>;
        clocks = <&clk UART1_GATE>;
        port-number = <1>;
        dmas = <&pdma2 2>, <&pdma3 3>;
        dma-names = "tx", "rx";
        nuvoton,pdma-reqsel-tx = <MA35_PDMA_REQ_UART1_TX>;
        nuvoton,pdma-reqsel-rx = <MA35_PDMA_REQ_UART1_RX>;
        pdma-enable = <1>;
        status = "disabled";
    };
...
```

## Documentation/devicetree/bindings/sound/nuvoton,ma35d1.yaml
```yaml
# SPDX-License-Identifier: (GPL-2.0-only OR BSD-2-Clause)
%YAML 1.2
---
$id: http://devicetree.org/schemas/sound/nuvoton,ma35d1.yaml#
$schema: http://devicetree.org/meta-schemas/core.yaml#

title: Nuvoton MA35 Series I2S Controller

maintainers:
  - Chi-Wen Weng <cwweng@nuvoton.com>

description: |
  The Nuvoton MA35D0, MA35D1 and MA35H0 I2S controllers provide serial
  audio interfaces for external codecs. The current driver supports
  full-duplex mono and stereo playback/capture, I2S, left-justified and
  right-justified formats, master and slave modes, and DMAengine PCM.

  The controller supplies the CPU DAI and the DMA interface. Audio
  connections, codec selection, and board-level clock policy are
  described by the sound card, normally using simple-audio-card.

allOf:
  - $ref: dai-common.yaml#
  - oneOf:
      - required:
          - nuvoton,pdma-reqsel-tx
        not:
          required:
            - pdma_reqsel_tx
      - required:
          - pdma_reqsel_tx
        not:
          required:
            - nuvoton,pdma-reqsel-tx
  - oneOf:
      - required:
          - nuvoton,pdma-reqsel-rx
        not:
          required:
            - pdma_reqsel_rx
      - required:
          - pdma_reqsel_rx
        not:
          required:
            - nuvoton,pdma-reqsel-rx

properties:
  compatible:
    enum:
      - nuvoton,ma35d0-i2s
      - nuvoton,ma35d1-i2s
      - nuvoton,ma35h0-i2s

  reg:
    maxItems: 1

  interrupts:
    maxItems: 1

  clocks:
    maxItems: 1
    description: I2S peripheral clock supplied by the MA35 clock controller.

  resets:
    maxItems: 1
    description: Optional reset control for the I2S controller.

  dmas:
    minItems: 2
    maxItems: 2
    description: DMA channels for playback and capture, respectively.

  dma-names:
    items:
      - const: tx
      - const: rx

  nuvoton,pdma-reqsel-tx:
    $ref: /schemas/types.yaml#/definitions/uint32
    enum: [86, 88]
    description: |
      MA35 PDMA hardware request selector for I2S transmission.
      I2S0 uses request 86 and I2S1 uses request 88.

  nuvoton,pdma-reqsel-rx:
    $ref: /schemas/types.yaml#/definitions/uint32
    enum: [87, 89]
    description: |
      MA35 PDMA hardware request selector for I2S reception.
      I2S0 uses request 87 and I2S1 uses request 89.

  pdma_reqsel_tx:
    $ref: /schemas/types.yaml#/definitions/uint32
    enum: [86, 88]
    deprecated: true
    description: Legacy alias for nuvoton,pdma-reqsel-tx.

  pdma_reqsel_rx:
    $ref: /schemas/types.yaml#/definitions/uint32
    enum: [87, 89]
    deprecated: true
    description: Legacy alias for nuvoton,pdma-reqsel-rx.

  mclk_out:
    $ref: /schemas/types.yaml#/definitions/uint32
    minimum: 1
    deprecated: true
    description: |
      Legacy requested MCLK frequency in Hz. When absent, the driver
      defaults to 12 MHz. A generic sound card may override the request
      through the CPU DAI set_sysclk() operation. New board descriptions
      should use the standard sound-card clock properties instead.

  powerdown-gpios:
    maxItems: 1
    deprecated: true
    description: |
      Legacy board-level external audio-path power-down control.
      The asserted state powers down the external audio path. New board
      designs should describe codec supplies and power controls using
      the appropriate codec or board-level bindings.

  '#sound-dai-cells':
    const: 0

required:
  - compatible
  - reg
  - interrupts
  - clocks
  - dmas
  - dma-names
  - '#sound-dai-cells'

unevaluatedProperties: false

examples:
  - |
    #include <dt-bindings/clock/nuvoton,ma35d1-clk.h>
    #include <dt-bindings/dma/nuvoton,ma35-pdma.h>
    #include <dt-bindings/interrupt-controller/arm-gic.h>
    #include <dt-bindings/reset/nuvoton,ma35d1-reset.h>

    i2s@40480000 {
        compatible = "nuvoton,ma35d1-i2s";
        reg = <0x40480000 0x10000>;
        interrupts = <GIC_SPI 70 IRQ_TYPE_LEVEL_HIGH>;
        clocks = <&clk I2S0_GATE>;
        resets = <&reset MA35D1_RESET_I2S0>;

        dmas = <&pdma0 0>, <&pdma0 1>;
        dma-names = "tx", "rx";
        nuvoton,pdma-reqsel-tx = <MA35_PDMA_REQ_I2S0_TX>;
        nuvoton,pdma-reqsel-rx = <MA35_PDMA_REQ_I2S0_RX>;

        #sound-dai-cells = <0>;
    };
...
```
