## Documentation/devicetree/bindings/spi/nuvoton,ma35d1-qspi.yaml
```yaml
# SPDX-License-Identifier: (GPL-2.0-only OR BSD-2-Clause)
%YAML 1.2
---
$id: http://devicetree.org/schemas/spi/nuvoton,ma35d1-qspi.yaml#
$schema: http://devicetree.org/meta-schemas/core.yaml#

title: Nuvoton MA35 Series Quad SPI Controller

maintainers:
  - Chi-Wen Weng <cwweng@nuvoton.com>

description: |
  The Quad SPI controller in the Nuvoton MA35D0, MA35D1, and MA35H0
  SoCs supports standard SPI transfers and SPI memory operations in
  single, dual, and quad I/O modes. The three SoCs use the same QSPI
  register layout and programming model.

allOf:
  - $ref: /schemas/spi/spi-controller.yaml#

properties:
  compatible:
    enum:
      - nuvoton,ma35d0-qspi
      - nuvoton,ma35d1-qspi
      - nuvoton,ma35h0-qspi

  reg:
    maxItems: 1

  interrupts:
    maxItems: 1

  clocks:
    maxItems: 1


  dmas:
    minItems: 2
    maxItems: 2

  dma-names:
    minItems: 2
    maxItems: 2
    items:
      - const: tx
      - const: rx

  pdma_reqsel_rx:
    $ref: /schemas/types.yaml#/definitions/uint32
    enum: [55, 57]
    description:
      PDMA request selector value used for QSPI receive transfers.

  pdma_reqsel_tx:
    $ref: /schemas/types.yaml#/definitions/uint32
    enum: [54, 56]
    description:
      PDMA request selector value used for QSPI transmit transfers.

  use_pdma:
    $ref: /schemas/types.yaml#/definitions/uint32
    enum: [0, 1]
    description: Select interrupt-driven or PDMA transfers.

  num_cs:
    $ref: /schemas/types.yaml#/definitions/uint32
    maximum: 2
    deprecated: true
    description: Legacy number of native chip selects.

  lsb:
    $ref: /schemas/types.yaml#/definitions/uint32
    enum: [0, 1]
    deprecated: true

  sleep:
    $ref: /schemas/types.yaml#/definitions/uint32
    deprecated: true

  txbitlen:
    $ref: /schemas/types.yaml#/definitions/uint32
    minimum: 1
    maximum: 32
    deprecated: true

  bus_num:
    $ref: /schemas/types.yaml#/definitions/uint32
    deprecated: true

  spimode:
    $ref: /schemas/types.yaml#/definitions/uint32
    maximum: 3
    deprecated: true

  quad:
    $ref: /schemas/types.yaml#/definitions/uint32
    enum: [0, 1]
    deprecated: true

  mrxphase:
    $ref: /schemas/types.yaml#/definitions/uint32
    maximum: 15
    deprecated: true

  num-cs:
    maximum: 2
    default: 2

dependencies:
  dmas:
    - dma-names
    - pdma_reqsel_rx
    - pdma_reqsel_tx
  dma-names:
    - dmas
  pdma_reqsel_rx:
    - dmas
  pdma_reqsel_tx:
    - dmas

required:
  - compatible
  - reg
  - interrupts
  - clocks

unevaluatedProperties: false

examples:
  - |
    #include <dt-bindings/interrupt-controller/arm-gic.h>
    #include <dt-bindings/clock/nuvoton,ma35d1-clk.h>
    #include <dt-bindings/dma/nuvoton,ma35-pdma.h>

    soc {
        #address-cells = <2>;
        #size-cells = <2>;

        spi@40680000 {
            compatible = "nuvoton,ma35d1-qspi";
            reg = <0 0x40680000 0 0x100>;
            interrupts = <GIC_SPI 57 IRQ_TYPE_LEVEL_HIGH>;
            clocks = <&clk QSPI0_GATE>;
            dmas = <&pdma1 0>, <&pdma1 1>;
            dma-names = "tx", "rx";
            pdma_reqsel_tx = <MA35_PDMA_REQ_QSPI0_TX>;
            pdma_reqsel_rx = <MA35_PDMA_REQ_QSPI0_RX>;
            use_pdma = <1>;
            #address-cells = <1>;
            #size-cells = <0>;
        };
    };
...
```

## Documentation/devicetree/bindings/thermal/nuvoton,ma35d1-tsen.yaml
```yaml
# SPDX-License-Identifier: (GPL-2.0-only OR BSD-2-Clause)
%YAML 1.2
---
$id: http://devicetree.org/schemas/thermal/nuvoton,ma35d1-tsen.yaml#
$schema: http://devicetree.org/meta-schemas/core.yaml#

title: Nuvoton MA35 Temperature Sensor

maintainers:
  - Chi-Wen Weng <cwweng@nuvoton.com>

description:
  Temperature sensor for Nuvoton MA35D1, MA35D0 and MA35H0 SoCs. The
  sensor registers are located in the system controller register block.

properties:
  compatible:
    enum:
      - nuvoton,ma35d1-tsen
      - nuvoton,ma35d0-tsen
      - nuvoton,ma35h0-tsen

  nuvoton,ma35d0-sys:
    $ref: /schemas/types.yaml#/definitions/phandle
    description: Phandle to the MA35D0 system controller.

  nuvoton,ma35d1-sys:
    $ref: /schemas/types.yaml#/definitions/phandle
    description:
      Phandle to the MA35 system controller syscon register block.

  nuvoton,ma35h0-sys:
    $ref: /schemas/types.yaml#/definitions/phandle
    description: Phandle to the MA35H0 system controller.

  "#thermal-sensor-cells":
    const: 0

required:
  - compatible
  - "#thermal-sensor-cells"

anyOf:
  - required: ["nuvoton,ma35d0-sys"]
  - required: ["nuvoton,ma35d1-sys"]
  - required: ["nuvoton,ma35h0-sys"]

additionalProperties: false

examples:
  - |
    temperature-sensor {
        compatible = "nuvoton,ma35d1-tsen";
        nuvoton,ma35d1-sys = <&sys>;
        #thermal-sensor-cells = <0>;
    };
...
```
